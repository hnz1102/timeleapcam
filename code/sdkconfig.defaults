## code/sdkconfig.defaults
```kconfig
CONFIG_ESP_MAIN_TASK_STACK_SIZE=16384
CONFIG_PTHREAD_TASK_STACK_SIZE_DEFAULT=16384
CONFIG_LWIP_SNTP_MAX_SERVERS=4
CONFIG_ESP32_SPIRAM_SUPPORT=y
CONFIG_SOC_PSRAM_DMA_CAPABLE=y
CONFIG_SPIRAM_SUPPORT=y
CONFIG_ESP32S3_SPIRAM_SUPPORT=y
CONFIG_SPIRAM_MODE_OCT=y
CONFIG_SPIRAM_SPEED_80M=y
CONFIG_ESP_TASK_WDT_EN=n
CONFIG_HTTPD_MAX_URI_LEN=1024
CONFIG_SPIRAM_USE=y
CONFIG_SPIRAM_MEMTEST=n
CONFIG_MBEDTLS_SSL_MAX_CONTENT_LEN=32696
CONFIG_CAMERA_TASK_STACK_SIZE=8192
CONFIG_ESP_DEFAULT_CPU_FREQ_MHZ_240=n
```
